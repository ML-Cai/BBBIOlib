/*
 * Copyright (C) 2012 Texas Instruments Incorporated - http://www.ti.com/
 *
 * This program is free software; you can redistribute it and/or modify
 * it under the terms of the GNU General Public License version 2 as
 * published by the Free Software Foundation.
 */

/include/ "am33xx.dtsi"

/include/ "am335x-bone-common.dtsi"

&am33xx_pinmux {
        ehrpwm0_pins: pinmux_ehrpwm0_pins {
                pinctrl-single,pins = <
                        0x154 0x3       /* spi0_d0.ehrpwm0A , OUTPUT_PULLDOWN | MODE3  P9_21*/
                        0x150 0x3       /* spi0_d0.ehrpwm0B , OUTPUT_PULLDOWN | MODE3  P9_22*/
                >;
        };
};

&epwmss0 {
        status = "okay";
};
&ehrpwm0 {
        status = "okay";
        pinctrl-names = "default";
        pinctrl-0 = <&ehrpwm0_pins>;
};

